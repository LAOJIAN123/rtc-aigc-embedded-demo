## client/espressif/esp32s3_demo/main/Kconfig.projbuild
```kconfig
menu "Example Configuration"

choice AI_AGENT_MODE
    prompt "Volcano RTC mode or Coze RTC mode"
    default VOLC_RTC_MODE

    config VOLC_RTC_MODE
        bool "enable volcano rtc mode"

    config COZE_RTC_MODE
        bool "enable coze rtc mode"
endchoice



config RTC_APPID
    string "RTC_APPID"
    default "******"
    depends on VOLC_RTC_MODE

config AIGENT_SERVER_HOST
    string "AIGC SERVER IP:PORT"
    default "8.134.112.73:8082"
    depends on VOLC_RTC_MODE

config RTC_ENDPOINT_ID
    string "Voice bot endpoint id"
    default "ep-20250315144244-pwq9g"
    depends on VOLC_RTC_MODE

config RTC_VOICE_TYPE
    string "Voice bot voice type"
    default "BV001_streaming"
    depends on VOLC_RTC_MODE

config COZE_SERVER_HOST
    string "Coze server host: https://www.coze.cn/open/docs/dev_how_to_guides/access_process"
    default "https://api.coze.cn/v1/audio/rooms"
    depends on COZE_RTC_MODE

config COZE_AUTH
    string "Coze authonrization: https://www.coze.cn/open/oauth/pats"
    depends on COZE_RTC_MODE

config COZE_BOT_ID
    string "Coze bot id: https://www.coze.cn/open/docs/guides/agent_quick_start"
    depends on COZE_RTC_MODE

choice AUDIO_CODEC_SUPPORT
    prompt "Audio Codec"
    default AUDIO_CODEC_TYPE_PCM

config AUDIO_CODEC_TYPE_PCM
    bool "audio codec is pcm, use internal audio codec instead"

config AUDIO_CODEC_TYPE_OPUS
    bool "audio codec is opus"
    depends on VOLC_RTC_MODE

config AUDIO_CODEC_TYPE_G711A
    bool "audio codec is g711a"

config AUDIO_CODEC_TYPE_G722
    bool "audio codec is g722, not support yet"

config AUDIO_CODEC_TYPE_AACLC
    bool "audio codec is aaclc, not support yet"

endchoice

# Multi-server connection reference commands:
# Start voice chat
# curl -X POST 'http://8.134.112.73:8082/startvoicechat' \
#   --header 'Content-Type: application/json' \
#   --header 'Authorization: af78e3067d51e0c3f66b3018f904e8c' \
#   --data '{
#     "end_point_id": "ep-20250315144244-pwq9g",
#     "voice_type": "BV001_streaming"
#   }'
#
# Stop voice chat
# curl -X POST 'http://8.134.112.73:8082/stopvoicechat' \
#   --header 'Content-Type: application/json' \
#   --header 'Authorization: af78e3067d51e0c3f66b3018f904e8c' \
#   --data '{
#     "app_id": "67d51e0c3f66b3018f904e8c",
#     "room_id": "TestRoom001",
#     "task_id": "TestTask001"
#   }'
endmenu
```
